## 3.0.11/issdfut_3.0.11_poky.tar/meta-issdfutcli/conf/layer.conf
```bitbake
# We have a conf and classes directory, add to BBPATH
BBPATH =. "${LAYERDIR}:"

# We have a packages directory, add to BBFILES
BBFILES += "${LAYERDIR}/recipes-*/*/*.bb \
            ${LAYERDIR}/recipes-*/*/*.bbappend"

BBFILE_COLLECTIONS += "issdfutcli"
BBFILE_PATTERN_issdfutcli = "^${LAYERDIR}/"
BBFILE_PRIORITY_issdfutcli = "6"

LICENSE_PATH += "${LAYERDIR}/licenses"

LAYERSERIES_COMPAT_issdfutcli = "thud morty"
```

## 3.0.11/issdfut_3.0.11_poky.tar/meta-issdfutcli/conf/machine/genericx86-64.conf
```bitbake
#@TYPE: Machine
#@NAME: Generic X86_64.

#@DESCRIPTION: Machine configuration for generic X86_64 (64-bit) PCs and servers. Supports a moderately wide range of drivers that should boot and be usable on "typical" hardware.

DEFAULTTUNE ?= "core2-64"
require conf/machine/include/tune-core2.inc
require conf/machine/include/genericx86-common.inc

MACHINE_ESSENTIAL_EXTRA_RRECOMMENDS += "gma500-gfx-check"

PREFERRED_VERSION_linux-yocto_genericx86-64 ?= "4.18%"

#SERIAL_CONSOLES_CHECK = "ttyS0"
```
